## config/boards/shields/unit01/Kconfig.defconfig
```kconfig
if SHIELD_UNIT01_LEFT

config ZMK_KEYBOARD_NAME
    default "Unit-01"

config ZMK_SPLIT_BLE_ROLE_CENTRAL
    default y

endif

if SHIELD_UNIT01_RIGHT

config ZMK_KEYBOARD_NAME
	default "Unit-01 Aux"
    
endif

if SHIELD_UNIT-01_LEFT || SHIELD_UNIT-01_RIGHT

config ZMK_SPLIT
    default y

endif
```

## config/boards/shields/unit01/Kconfig.shield
```kconfig
config SHIELD_UNIT-01_LEFT
	def_bool $(shields_list_contains,unit01_left)

config SHIELD_UNIT-01_RIGHT
	def_bool $(shields_list_contains,unit01_right)
```

## config/west.yml
```yaml
manifest:
  remotes:
    - name: unit01
      url-base: https://github.com/jasepellerin
  projects:
    - name: zmk
      remote: jasepellerin
      revision: main
      import: app/west.yml
  self:
    path: config
```
