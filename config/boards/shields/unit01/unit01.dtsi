#include <dt-bindings/zmk/matrix_transform.h>

/ {

	chosen {
		zmk,kscan = &kscan0;
		zmk,matrix_transform = &default_transform;
	};

	default_transform: keymap_transform_0 {
		compatible = "zmk,matrix-transform";
		columns = <32>;
		rows = <1>;
		map = <
						 RC(0,0)
		>;
	};

	kscan0: kscan {
		compatible = "zmk,kscan-gpio-direct";
		label = "KSCAN";
		input-gpios
		= <&pro_micro 5 (GPIO_ACTIVE_LOW | GPIO_PULL_UP)>
		;
	};

};